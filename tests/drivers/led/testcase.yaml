## tests/drivers/led/testcase.yaml
```yaml
tests:
  unity.led_test:
    tags: led_test
    integration_platforms:
      - native_sim_64
    platform_allow:
      - native_sim_64
```

## tests/services/hls/testcase.yaml
```yaml
tests:
  unity.hls_test:
    tags: hls_test
    integration_platforms:
      - native_sim_64
    platform_allow:
      - native_sim_64
```
